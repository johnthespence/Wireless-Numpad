## boards/shields/wireless_numpad/Kconfig.defconfig
```kconfig
if SHIELD_WIRELESS_NUMPAD

# Name must be less than 16 characters long!
config ZMK_KEYBOARD_NAME
    default "Wireless Numpad"

endif
```

## boards/shields/wireless_numpad/Kconfig.shield
```kconfig
config SHIELD_WIRELESS_NUMPAD
    def_bool $(shields_list_contains,wireless_numpad)
```
